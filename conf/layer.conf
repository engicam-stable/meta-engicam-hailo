## conf/layer.conf
```bitbake
# We have a conf and classes directory, add to BBPATH
BBPATH .= ":${LAYERDIR}"

# We have recipes-* directories, add to BBFILES
BBFILES += "${LAYERDIR}/recipes-*/*/*.bb \
            ${LAYERDIR}/recipes-*/*/*.bbappend"

BBFILE_COLLECTIONS += "meta-engicam-hailo"
BBFILE_PATTERN_meta-engicam-hailo = "^${LAYERDIR}/"
BBFILE_PRIORITY_meta-engicam-hailo = "7"

LAYERDEPENDS_meta-engicam-hailo = "core"
LAYERSERIES_COMPAT_meta-engicam-hailo = "kirkstone"
```

## conf/machine/hailo15-smarcore.conf
```bitbake
require conf/machine/hailo15-base.inc

UBOOT_MACHINE = "hailo15_smarcore_defconfig"
```
